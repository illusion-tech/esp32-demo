## main/Kconfig.projbuild
```kconfig
menu "App Configuration"

    config HW507_GPIO
        int "HW507 GPIO number"
        range 0 48
        default 10 if IDF_TARGET_ESP32C3
        default 10

    config LED_R_GPIO
        int "LED R GPIO number"
        range 0 48
        default 3

    config LED_G_GPIO
        int "LED G GPIO number"
        range 0 48
        default 4

    config LED_B_GPIO
        int "LED B GPIO number"
        range 0 48
        default 5

    config ESP_WIFI_SSID
        string "WiFi SSID"
        default "TP-LINK_Xccx_2.4G"
        help
            SSID (network name) for the example to connect to.

    config ESP_WIFI_PASSWORD
        string "WiFi Password"
        default "12341234"
        help
            WiFi password (WPA or WPA2) for the example to use.

    config ESP_MAXIMUM_RETRY
        int "Maximum retry"
        default 5
        help
            Set the Maximum retry to avoid station reconnecting to the AP unlimited when the AP is really inexistent.

    choice ESP_WIFI_SCAN_AUTH_MODE_THRESHOLD
        prompt "WiFi Scan auth mode threshold"
        default ESP_WIFI_AUTH_OPEN
        help
            The weakest authmode to accept in the scan mode.

        config ESP_WIFI_AUTH_OPEN
            bool "OPEN"
        config ESP_WIFI_AUTH_WEP
            bool "WEP"
        config ESP_WIFI_AUTH_WPA_PSK
            bool "WPA PSK"
        config ESP_WIFI_AUTH_WPA2_PSK
            bool "WPA2 PSK"
        config ESP_WIFI_AUTH_WPA_WPA2_PSK
            bool "WPA/WPA2 PSK"
        config ESP_WIFI_AUTH_WPA3_PSK
            bool "WPA3 PSK"
        config ESP_WIFI_AUTH_WPA2_WPA3_PSK
            bool "WPA2/WPA3 PSK"
        config ESP_WIFI_AUTH_WAPI_PSK
            bool "WAPI PSK"
    endchoice

endmenu
```
